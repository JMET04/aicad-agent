## CMakeLists.txt
```
# Reusable Zephyr source fragment for the receiver-effects application.
# The real receiver application must call add_subdirectory() after
# find_package(Zephyr); this fragment is deliberately not a standalone app.

if(NOT TARGET app)
    message(FATAL_ERROR
        "receiver-effects epoch storage must be added from a Zephyr app after find_package(Zephyr)"
    )
endif()

target_sources(app PRIVATE
    ${CMAKE_CURRENT_LIST_DIR}/src/mw_epoch_record.c
    ${CMAKE_CURRENT_LIST_DIR}/src/mw_epoch_store.c
    ${CMAKE_CURRENT_LIST_DIR}/src/mw_epoch_nvs.c
)

target_include_directories(app PRIVATE
    ${CMAKE_CURRENT_LIST_DIR}/src
)
```

## prj.conf
```kconfig
# Candidate configuration for nRF Connect SDK v3.4.0 / Zephyr v4.4.0.
# Presence of this file is not evidence of a target build, flash or HIL pass.
CONFIG_FLASH=y
CONFIG_FLASH_MAP=y
CONFIG_FLASH_PAGE_LAYOUT=y
CONFIG_NVS=y
CONFIG_NVS_DATA_CRC=y

# Required when the ARM MPU protects internal flash writes on this target.
CONFIG_MPU_ALLOW_FLASH_WRITE=y
```

## src/mw_epoch_nvs.c
```c
#include "mw_epoch_nvs.h"

#include <errno.h>
#include <limits.h>
#include <string.h>

#include <zephyr/device.h>
#include <zephyr/devicetree.h>
#include <zephyr/drivers/flash.h>
#include <zephyr/storage/flash_map.h>
#include <zephyr/sys/util.h>

#define MW_EPOCH_PARTITION_NODE DT_NODELABEL(mw_epoch_partition)
#define MW_EPOCH_NVS_ID_BASE UINT16_C(0x4D00)
#define MW_EPOCH_NVS_LAST_ID \
    (MW_EPOCH_NVS_ID_BASE + \
     (MW_EPOCH_LOGICAL_CHANNEL_COUNT * MW_EPOCH_SLOT_COUNT) - 1U)

#if !DT_NODE_HAS_STATUS(MW_EPOCH_PARTITION_NODE, okay)
#error "An enabled dedicated mw_epoch_partition devicetree node is required"
#endif

#if !defined(CONFIG_NVS_DATA_CRC)
#error "CONFIG_NVS_DATA_CRC=y is mandatory for the epoch NVS adapter"
#endif

BUILD_ASSERT(MW_EPOCH_SLOT_COUNT == 2U,
             "The epoch journal requires exactly two A/B slots");
BUILD_ASSERT(MW_EPOCH_NVS_LAST_ID <= UINT16_MAX,
             "The epoch NVS ID range must fit uint16_t");

static uint16_t slot_id(uint8_t logical_channel, uint8_t copy_index)
{
    const uint16_t offset = (uint16_t)(
        ((uint16_t)logical_channel * (uint16_t)MW_EPOCH_SLOT_COUNT)
        + (uint16_t)copy_index);
    return (uint16_t)(MW_EPOCH_NVS_ID_BASE + offset);
}

static bool partition_overlaps_settings(void)
{
#if DT_NODE_HAS_STATUS(DT_NODELABEL(storage_partition), okay)
    const struct device *epoch_device =
        PARTITION_NODE_DEVICE(MW_EPOCH_PARTITION_NODE);
    const struct device *settings_device =
        PARTITION_NODE_DEVICE(DT_NODELABEL(storage_partition));
    const uint64_t epoch_start =
        (uint64_t)PARTITION_NODE_OFFSET(MW_EPOCH_PARTITION_NODE);
    const uint64_t epoch_end = epoch_start
        + (uint64_t)PARTITION_NODE_SIZE(MW_EPOCH_PARTITION_NODE);
    const uint64_t settings_start =
        (uint64_t)PARTITION_NODE_OFFSET(DT_NODELABEL(storage_partition));
    const uint64_t settings_end = settings_start
        + (uint64_t)PARTITION_NODE_SIZE(DT_NODELABEL(storage_partition));

    return (epoch_device == settings_device)
        && (epoch_start < settings_end)
        && (settings_start < epoch_end);
#else
    return false;
#endif
}

static mw_epoch_slot_state_t nvs_read_slot(
    void *context,
    uint8_t logical_channel,
    uint8_t copy_index,
    uint8_t data_out[MW_EPOCH_RECORD_ENCODED_SIZE],
    size_t *stored_length_out
)
{
    mw_epoch_nvs_adapter_t *adapter = (mw_epoch_nvs_adapter_t *)context;
    ssize_t result;

    if (stored_length_out != NULL) {
        *stored_length_out = 0U;
    }
    if ((adapter == NULL)
        || !adapter->mounted
        || (logical_channel >= MW_EPOCH_LOGICAL_CHANNEL_COUNT)
        || (copy_index >= MW_EPOCH_SLOT_COUNT)
        || (data_out == NULL)
        || (stored_length_out == NULL)) {
        return MW_EPOCH_SLOT_IO_ERROR;
    }

    result = nvs_read(
        &adapter->fs,
        slot_id(logical_channel, copy_index),
        data_out,
        MW_EPOCH_RECORD_ENCODED_SIZE);
    if (result == -ENOENT) {
        return MW_EPOCH_SLOT_ENOENT;
    }
    if (result < 0) {
        return MW_EPOCH_SLOT_IO_ERROR;
    }

    *stored_length_out = (size_t)result;
    return MW_EPOCH_SLOT_PRESENT;
}

static int32_t nvs_write_slot(
    void *context,
    uint8_t logical_channel,
    uint8_t copy_index,
    const uint8_t *data,
    size_t data_length
)
{
    mw_epoch_nvs_adapter_t *adapter = (mw_epoch_nvs_adapter_t *)context;
    ssize_t result;

    if ((adapter == NULL)
        || !adapter->mounted
        || (logical_channel >= MW_EPOCH_LOGICAL_CHANNEL_COUNT)
        || (copy_index >= MW_EPOCH_SLOT_COUNT)
        || (data == NULL)
        || (data_length != MW_EPOCH_RECORD_ENCODED_SIZE)) {
        return -EINVAL;
    }

    result = nvs_write(
        &adapter->fs,
        slot_id(logical_channel, copy_index),
        data,
        data_length);
    if ((result > (ssize_t)INT32_MAX) || (result < (ssize_t)INT32_MIN)) {
        return -EOVERFLOW;
    }
    return (int32_t)result;
}

static void clear_ram_window_unlocked(
    mw_epoch_nvs_channel_context_t *context
)
{
    context->ram_session_id = 0U;
    context->ram_sequence_ceiling = 0U;
    context->ram_receive_high_water = 0U;
    context->ram_window_bound = false;
}

static bool lock_mounted(mw_epoch_nvs_adapter_t *adapter)
{
    return (adapter != NULL)
        && adapter->mounted
        && (k_mutex_lock(&adapter->mutex, K_FOREVER) == 0);
}

int mw_epoch_nvs_mount(mw_epoch_nvs_adapter_t *adapter)
{
    const struct device *flash_device;
    struct flash_pages_info page_info;
    mw_epoch_store_backend_t backend;
    size_t partition_size;
    size_t page_size;
    size_t sector_count;
    unsigned int channel;
    int result;

    if (adapter == NULL) {
        return -EINVAL;
    }
    (void)memset(adapter, 0, sizeof(*adapter));
    k_mutex_init(&adapter->mutex);

    if (partition_overlaps_settings()) {
        return -EINVAL;
    }
    flash_device = PARTITION_NODE_DEVICE(MW_EPOCH_PARTITION_NODE);
    if (!device_is_ready(flash_device)) {
        return -ENODEV;
    }

    adapter->fs.flash_device = flash_device;
    adapter->fs.offset = PARTITION_NODE_OFFSET(MW_EPOCH_PARTITION_NODE);
    result = flash_get_page_info_by_offs(
        flash_device, adapter->fs.offset, &page_info);
    if (result != 0) {
        return result;
    }

    partition_size = (size_t)PARTITION_NODE_SIZE(MW_EPOCH_PARTITION_NODE);
    page_size = page_info.size;
    if ((page_size == 0U)
        || (page_size > UINT16_MAX)
        || ((page_size & (page_size - 1U)) != 0U)
        || (page_info.start_offset != adapter->fs.offset)
        || (partition_size < (2U * page_size))
        || ((partition_size % page_size) != 0U)) {
        return -EINVAL;
    }
    sector_count = partition_size / page_size;
    if ((sector_count < 2U) || (sector_count > UINT16_MAX)) {
        return -EINVAL;
    }

    adapter->fs.sector_size = (uint32_t)page_size;
    adapter->fs.sector_count = (uint16_t)sector_count;
    result = nvs_mount(&adapter->fs);
    if (result != 0) {
        return result;
    }

    backend.read_slot = nvs_read_slot;
    backend.write_slot = nvs_write_slot;
    backend.context = adapter;
    if (!mw_epoch_store_init(&adapter->store, &backend)) {
        return -EINVAL;
    }
    for (channel = 0U; channel < MW_EPOCH_LOGICAL_CHANNEL_COUNT; ++channel) {
        adapter->channels[channel].adapter = adapter;
        adapter->channels[channel].logical_channel = (uint8_t)channel;
        clear_ram_window_unlocked(&adapter->channels[channel]);
    }
    adapter->mounted = true;
    return 0;
}

mw_epoch_store_result_t mw_epoch_nvs_load_channel(
    mw_epoch_nvs_adapter_t *adapter,
    uint8_t logical_channel,
    uint32_t receiver_id,
    uint32_t wand_id,
    uint32_t configured_sequence_ceiling,
    mw_epoch_provisioning_policy_t provisioning_policy
)
{
    mw_epoch_store_result_t result;

    if ((logical_channel >= MW_EPOCH_LOGICAL_CHANNEL_COUNT)
        || !lock_mounted(adapter)) {
        return MW_EPOCH_STORE_NOT_READY;
    }
    clear_ram_window_unlocked(&adapter->channels[logical_channel]);
    result = mw_epoch_store_load_channel(
        &adapter->store,
        logical_channel,
        receiver_id,
        wand_id,
        configured_sequence_ceiling,
        provisioning_policy);
    k_mutex_unlock(&adapter->mutex);
    return result;
}

mw_epoch_store_result_t mw_epoch_nvs_provision_channel(
    mw_epoch_nvs_adapter_t *adapter,
    uint8_t logical_channel
)
{
    mw_epoch_store_result_t result;

    if ((logical_channel >= MW_EPOCH_LOGICAL_CHANNEL_COUNT)
        || !lock_mounted(adapter)) {
        return MW_EPOCH_STORE_NOT_READY;
    }
    clear_ram_window_unlocked(&adapter->channels[logical_channel]);
    result = mw_epoch_store_provision_channel(
        &adapter->store, logical_channel);
    k_mutex_unlock(&adapter->mutex);
    return result;
}

bool mw_epoch_nvs_snapshot(
    mw_epoch_nvs_adapter_t *adapter,
    uint8_t logical_channel,
    mw_epoch_record_t *record_out
)
{
    bool result;

    if ((logical_channel >= MW_EPOCH_LOGICAL_CHANNEL_COUNT)
        || !lock_mounted(adapter)) {
        if (record_out != NULL) {
            const mw_epoch_record_t zero = {0};
            *record_out = zero;
        }
        return false;
    }
    result = mw_epoch_store_snapshot(
        &adapter->store, logical_channel, record_out);
    k_mutex_unlock(&adapter->mutex);
    return result;
}

mw_epoch_nvs_channel_context_t *mw_epoch_nvs_channel_context(
    mw_epoch_nvs_adapter_t *adapter,
    uint8_t logical_channel
)
{
    if ((adapter == NULL)
        || !adapter->mounted
        || (logical_channel >= MW_EPOCH_LOGICAL_CHANNEL_COUNT)) {
        return NULL;
    }
    return &adapter->channels[logical_channel];
}

bool mw_epoch_nvs_commit_session_epoch(
    void *context,
    uint32_t next_session_id
)
{
    mw_epoch_nvs_channel_context_t *channel =
        (mw_epoch_nvs_channel_context_t *)context;
    mw_epoch_nvs_adapter_t *adapter;
    mw_epoch_store_result_t result;

    if ((channel == NULL) || (channel->adapter == NULL)) {
        return false;
    }
    adapter = channel->adapter;
    if ((channel->logical_channel >= MW_EPOCH_LOGICAL_CHANNEL_COUNT)
        || (&adapter->channels[channel->logical_channel] != channel)
        || !lock_mounted(adapter)) {
        return false;
    }

    clear_ram_window_unlocked(channel);
    result = mw_epoch_store_commit_session(
        &adapter->store, channel->logical_channel, next_session_id);
    k_mutex_unlock(&adapter->mutex);
    return result == MW_EPOCH_STORE_OK;
}

bool mw_epoch_nvs_bind_ram_window(
    mw_epoch_nvs_channel_context_t *context,
    uint32_t durable_session_id,
    uint32_t reserved_sequence_ceiling
)
{
    mw_epoch_nvs_adapter_t *adapter;
    mw_epoch_record_t current;
    bool valid;

    if ((context == NULL) || (context->adapter == NULL)) {
        return false;
    }
    adapter = context->adapter;
    if ((context->logical_channel >= MW_EPOCH_LOGICAL_CHANNEL_COUNT)
        || (&adapter->channels[context->logical_channel] != context)
        || !lock_mounted(adapter)) {
        return false;
    }

    clear_ram_window_unlocked(context);
    valid = mw_epoch_store_snapshot(
        &adapter->store, context->logical_channel, &current)
        && (durable_session_id != 0U)
        && (durable_session_id != UINT32_MAX)
        && (reserved_sequence_ceiling != 0U)
        && (reserved_sequence_ceiling != UINT32_MAX)
        && (current.session_id == durable_session_id)
        && (current.sequence_ceiling == reserved_sequence_ceiling);
    if (valid) {
        context->ram_session_id = durable_session_id;
        context->ram_sequence_ceiling = reserved_sequence_ceiling;
        context->ram_receive_high_water = 0U;
        context->ram_window_bound = true;
    }
    k_mutex_unlock(&adapter->mutex);
    return valid;
}

bool mw_epoch_nvs_commit_ram_high_water(
    void *context,
    uint32_t sequence
)
{
    mw_epoch_nvs_channel_context_t *channel =
        (mw_epoch_nvs_channel_context_t *)context;
    mw_epoch_nvs_adapter_t *adapter;
    mw_epoch_record_t current;
    bool valid;

    if ((channel == NULL) || (channel->adapter == NULL)) {
        return false;
    }
    adapter = channel->adapter;
    if ((channel->logical_channel >= MW_EPOCH_LOGICAL_CHANNEL_COUNT)
        || (&adapter->channels[channel->logical_channel] != channel)
        || !lock_mounted(adapter)) {
        return false;
    }

    valid = channel->ram_window_bound
        && mw_epoch_store_snapshot(
            &adapter->store, channel->logical_channel, &current)
        && (current.session_id == channel->ram_session_id)
        && (current.sequence_ceiling == channel->ram_sequence_ceiling)
        && (sequence != 0U)
        && (sequence != UINT32_MAX)
        && (sequence > channel->ram_receive_high_water)
        && (sequence <= channel->ram_sequence_ceiling);
    if (valid) {
        channel->ram_receive_high_water = sequence;
    } else {
        clear_ram_window_unlocked(channel);
    }
    k_mutex_unlock(&adapter->mutex);
    return valid;
}

void mw_epoch_nvs_clear_ram_window(
    mw_epoch_nvs_channel_context_t *context
)
{
    mw_epoch_nvs_adapter_t *adapter;

    if ((context == NULL) || (context->adapter == NULL)) {
        return;
    }
    adapter = context->adapter;
    if ((context->logical_channel >= MW_EPOCH_LOGICAL_CHANNEL_COUNT)
        || (&adapter->channels[context->logical_channel] != context)
        || !lock_mounted(adapter)) {
        return;
    }
    clear_ram_window_unlocked(context);
    k_mutex_unlock(&adapter->mutex);
}

void mw_epoch_nvs_invalidate_channel(
    mw_epoch_nvs_adapter_t *adapter,
    uint8_t logical_channel
)
{
    if ((logical_channel >= MW_EPOCH_LOGICAL_CHANNEL_COUNT)
        || !lock_mounted(adapter)) {
        return;
    }
    mw_epoch_store_invalidate_channel(&adapter->store, logical_channel);
    clear_ram_window_unlocked(&adapter->channels[logical_channel]);
    k_mutex_unlock(&adapter->mutex);
}
```

## src/mw_epoch_nvs.h
```c
#ifndef MW_EPOCH_NVS_H
#define MW_EPOCH_NVS_H

#include "mw_epoch_store.h"

#include <stdbool.h>
#include <stdint.h>

#include <zephyr/kernel.h>
#include <zephyr/kvss/nvs.h>

typedef struct mw_epoch_nvs_adapter mw_epoch_nvs_adapter_t;

typedef struct {
    mw_epoch_nvs_adapter_t *adapter;
    uint8_t logical_channel;
    uint32_t ram_session_id;
    uint32_t ram_sequence_ceiling;
    uint32_t ram_receive_high_water;
    bool ram_window_bound;
} mw_epoch_nvs_channel_context_t;

struct mw_epoch_nvs_adapter {
    struct nvs_fs fs;
    struct k_mutex mutex;
    mw_epoch_store_t store;
    mw_epoch_nvs_channel_context_t channels[MW_EPOCH_LOGICAL_CHANNEL_COUNT];
    bool mounted;
};

/*
 * Mounts only DT_NODELABEL(mw_epoch_partition). The implementation refuses an
 * overlap with storage_partition and requires CONFIG_NVS_DATA_CRC=y. No caller
 * may use the adapter after a non-zero result.
 */
int mw_epoch_nvs_mount(mw_epoch_nvs_adapter_t *adapter);

mw_epoch_store_result_t mw_epoch_nvs_load_channel(
    mw_epoch_nvs_adapter_t *adapter,
    uint8_t logical_channel,
    uint32_t receiver_id,
    uint32_t wand_id,
    uint32_t configured_sequence_ceiling,
    mw_epoch_provisioning_policy_t provisioning_policy
);

mw_epoch_store_result_t mw_epoch_nvs_provision_channel(
    mw_epoch_nvs_adapter_t *adapter,
    uint8_t logical_channel
);

bool mw_epoch_nvs_snapshot(
    mw_epoch_nvs_adapter_t *adapter,
    uint8_t logical_channel,
    mw_epoch_record_t *record_out
);

mw_epoch_nvs_channel_context_t *mw_epoch_nvs_channel_context(
    mw_epoch_nvs_adapter_t *adapter,
    uint8_t logical_channel
);

/*
 * Pass this to mw_receiver_*_complete_handshake. It returns true only after the
 * pure-C transaction has accepted nvs_write=32 or 0, fully read both slots,
 * verified exact candidate bytes, reselected the candidate and updated current.
 * An authenticated ACK is forbidden before this callback returns true.
 */
bool mw_epoch_nvs_commit_session_epoch(
    void *context,
    uint32_t next_session_id
);

/*
 * Call only after portable runtime durable-window bind succeeds and before ACK.
 * The resulting high-water callback is session-local RAM only; the committed
 * epoch makes same-session reset recovery fail closed.
 */
bool mw_epoch_nvs_bind_ram_window(
    mw_epoch_nvs_channel_context_t *context,
    uint32_t durable_session_id,
    uint32_t reserved_sequence_ceiling
);

bool mw_epoch_nvs_commit_ram_high_water(
    void *context,
    uint32_t sequence
);

void mw_epoch_nvs_clear_ram_window(
    mw_epoch_nvs_channel_context_t *context
);

void mw_epoch_nvs_invalidate_channel(
    mw_epoch_nvs_adapter_t *adapter,
    uint8_t logical_channel
);

#endif
```

## src/mw_epoch_record.c
```c
#include "mw_epoch_record.h"

#include <string.h>

#define MW_EPOCH_MAGIC_0 ((uint8_t)'M')
#define MW_EPOCH_MAGIC_1 ((uint8_t)'W')
#define MW_EPOCH_MAGIC_2 ((uint8_t)'E')
#define MW_EPOCH_MAGIC_3 ((uint8_t)'P')
#define MW_EPOCH_CRC_OFFSET 28U
#define MW_EPOCH_CRC32_POLYNOMIAL UINT32_C(0xEDB88320)

static void zero_record(mw_epoch_record_t *record)
{
    if (record != NULL) {
        const mw_epoch_record_t zero = {0};
        *record = zero;
    }
}

static void put_u32_be(uint8_t *destination, uint32_t value)
{
    destination[0] = (uint8_t)(value >> 24U);
    destination[1] = (uint8_t)(value >> 16U);
    destination[2] = (uint8_t)(value >> 8U);
    destination[3] = (uint8_t)value;
}

static uint32_t get_u32_be(const uint8_t *source)
{
    return ((uint32_t)source[0] << 24U)
        | ((uint32_t)source[1] << 16U)
        | ((uint32_t)source[2] << 8U)
        | (uint32_t)source[3];
}

static uint32_t crc32_iso_hdlc(const uint8_t *data, size_t length)
{
    uint32_t crc = UINT32_MAX;
    size_t byte_index;

    for (byte_index = 0U; byte_index < length; ++byte_index) {
        unsigned int bit_index;
        crc ^= (uint32_t)data[byte_index];
        for (bit_index = 0U; bit_index < 8U; ++bit_index) {
            const uint32_t mask = 0U - (crc & 1U);
            crc = (crc >> 1U) ^ (MW_EPOCH_CRC32_POLYNOMIAL & mask);
        }
    }
    return ~crc;
}

static bool counter_is_active(uint32_t value)
{
    return (value != 0U) && (value != UINT32_MAX);
}

static bool identities_are_valid(uint32_t receiver_id, uint32_t wand_id)
{
    return (receiver_id != 0U)
        && (wand_id != 0U)
        && (receiver_id != wand_id);
}

static bool record_values_are_valid(const mw_epoch_record_t *record)
{
    if ((record == NULL)
        || (record->logical_channel >= MW_EPOCH_LOGICAL_CHANNEL_COUNT)
        || (record->copy_index >= MW_EPOCH_SLOT_COUNT)
        || !counter_is_active(record->generation)
        || !identities_are_valid(record->receiver_id, record->wand_id)) {
        return false;
    }

    if (record->session_id == 0U) {
        return (record->generation == 1U)
            && (record->sequence_ceiling == 0U);
    }

    return counter_is_active(record->session_id)
        && counter_is_active(record->sequence_ceiling);
}

bool mw_epoch_record_encode(
    const mw_epoch_record_t *record,
    uint8_t encoded[MW_EPOCH_RECORD_ENCODED_SIZE]
)
{
    uint32_t crc;

    if (encoded == NULL) {
        return false;
    }
    (void)memset(encoded, 0, MW_EPOCH_RECORD_ENCODED_SIZE);
    if (!record_values_are_valid(record)) {
        return false;
    }

    encoded[0] = MW_EPOCH_MAGIC_0;
    encoded[1] = MW_EPOCH_MAGIC_1;
    encoded[2] = MW_EPOCH_MAGIC_2;
    encoded[3] = MW_EPOCH_MAGIC_3;
    encoded[4] = MW_EPOCH_RECORD_SCHEMA_V1;
    encoded[5] = record->logical_channel;
    encoded[6] = record->copy_index;
    encoded[7] = 0U;
    put_u32_be(&encoded[8], record->generation);
    put_u32_be(&encoded[12], record->receiver_id);
    put_u32_be(&encoded[16], record->wand_id);
    put_u32_be(&encoded[20], record->session_id);
    put_u32_be(&encoded[24], record->sequence_ceiling);
    crc = crc32_iso_hdlc(encoded, MW_EPOCH_CRC_OFFSET);
    put_u32_be(&encoded[MW_EPOCH_CRC_OFFSET], crc);
    return true;
}

bool mw_epoch_record_decode(
    const uint8_t *encoded,
    size_t encoded_length,
    mw_epoch_record_t *record
)
{
    mw_epoch_record_t decoded;
    uint32_t stored_crc;
    uint32_t computed_crc;

    zero_record(record);
    if ((encoded == NULL)
        || (record == NULL)
        || (encoded_length != MW_EPOCH_RECORD_ENCODED_SIZE)) {
        return false;
    }
    if ((encoded[0] != MW_EPOCH_MAGIC_0)
        || (encoded[1] != MW_EPOCH_MAGIC_1)
        || (encoded[2] != MW_EPOCH_MAGIC_2)
        || (encoded[3] != MW_EPOCH_MAGIC_3)
        || (encoded[4] != MW_EPOCH_RECORD_SCHEMA_V1)
        || (encoded[7] != 0U)) {
        return false;
    }

    stored_crc = get_u32_be(&encoded[MW_EPOCH_CRC_OFFSET]);
    computed_crc = crc32_iso_hdlc(encoded, MW_EPOCH_CRC_OFFSET);
    if (stored_crc != computed_crc) {
        return false;
    }

    decoded.logical_channel = encoded[5];
    decoded.copy_index = encoded[6];
    decoded.generation = get_u32_be(&encoded[8]);
    decoded.receiver_id = get_u32_be(&encoded[12]);
    decoded.wand_id = get_u32_be(&encoded[16]);
    decoded.session_id = get_u32_be(&encoded[20]);
    decoded.sequence_ceiling = get_u32_be(&encoded[24]);
    if (!record_values_are_valid(&decoded)) {
        return false;
    }

    *record = decoded;
    return true;
}

bool mw_epoch_record_make_factory_baseline(
    uint8_t logical_channel,
    uint8_t copy_index,
    uint32_t receiver_id,
    uint32_t wand_id,
    mw_epoch_record_t *record
)
{
    mw_epoch_record_t baseline;

    zero_record(record);
    if (record == NULL) {
        return false;
    }
    baseline.logical_channel = logical_channel;
    baseline.copy_index = copy_index;
    baseline.generation = 1U;
    baseline.receiver_id = receiver_id;
    baseline.wand_id = wand_id;
    baseline.session_id = 0U;
    baseline.sequence_ceiling = 0U;
    if (!record_values_are_valid(&baseline)) {
        return false;
    }
    *record = baseline;
    return true;
}

bool mw_epoch_record_prepare_next(
    const mw_epoch_record_t *current,
    uint32_t next_session_id,
    uint32_t sequence_ceiling,
    mw_epoch_record_t *next
)
{
    mw_epoch_record_t candidate;

    zero_record(next);
    if ((next == NULL)
        || !record_values_are_valid(current)
        || !counter_is_active(next_session_id)
        || !counter_is_active(sequence_ceiling)
        || (current->generation >= (UINT32_MAX - 1U))
        || (next_session_id <= current->session_id)) {
        return false;
    }

    candidate.logical_channel = current->logical_channel;
    candidate.copy_index = (uint8_t)(1U - current->copy_index);
    candidate.generation = current->generation + 1U;
    candidate.receiver_id = current->receiver_id;
    candidate.wand_id = current->wand_id;
    candidate.session_id = next_session_id;
    candidate.sequence_ceiling = sequence_ceiling;
    if (!record_values_are_valid(&candidate)) {
        return false;
    }
    *next = candidate;
    return true;
}

static bool slot_view_contract_is_valid(const mw_epoch_slot_view_t *slot)
{
    if (slot->state == MW_EPOCH_SLOT_PRESENT) {
        return slot->data != NULL;
    }
    if ((slot->state == MW_EPOCH_SLOT_ENOENT)
        || (slot->state == MW_EPOCH_SLOT_IO_ERROR)) {
        return (slot->data == NULL) && (slot->length == 0U);
    }
    return false;
}

mw_epoch_select_result_t mw_epoch_record_select(
    const mw_epoch_slot_view_t slots[MW_EPOCH_SLOT_COUNT],
    uint8_t expected_logical_channel,
    uint32_t expected_receiver_id,
    uint32_t expected_wand_id,
    mw_epoch_provisioning_policy_t provisioning_policy,
    mw_epoch_record_t *selected
)
{
    mw_epoch_record_t decoded[MW_EPOCH_SLOT_COUNT] = {0};
    unsigned int present_count = 0U;
    unsigned int slot_index;

    zero_record(selected);
    if ((slots == NULL)
        || (selected == NULL)
        || (expected_logical_channel >= MW_EPOCH_LOGICAL_CHANNEL_COUNT)
        || !identities_are_valid(expected_receiver_id, expected_wand_id)
        || ((provisioning_policy != MW_EPOCH_REQUIRE_EXISTING)
            && (provisioning_policy != MW_EPOCH_ALLOW_EXPLICIT_PROVISIONING))) {
        return MW_EPOCH_SELECT_INVALID_ARGUMENT;
    }

    /* Validate both views and give any backend I/O error global precedence. */
    for (slot_index = 0U; slot_index < MW_EPOCH_SLOT_COUNT; ++slot_index) {
        if (!slot_view_contract_is_valid(&slots[slot_index])) {
            return MW_EPOCH_SELECT_INVALID_ARGUMENT;
        }
    }
    for (slot_index = 0U; slot_index < MW_EPOCH_SLOT_COUNT; ++slot_index) {
        if (slots[slot_index].state == MW_EPOCH_SLOT_IO_ERROR) {
            return MW_EPOCH_SELECT_IO_ERROR;
        }
    }

    for (slot_index = 0U; slot_index < MW_EPOCH_SLOT_COUNT; ++slot_index) {
        const mw_epoch_slot_view_t *slot = &slots[slot_index];
        if (slot->state == MW_EPOCH_SLOT_ENOENT) {
            continue;
        }
        if (!mw_epoch_record_decode(slot->data, slot->length, &decoded[slot_index])
            || (decoded[slot_index].copy_index != (uint8_t)slot_index)
            || (decoded[slot_index].logical_channel != expected_logical_channel)
            || (decoded[slot_index].receiver_id != expected_receiver_id)
            || (decoded[slot_index].wand_id != expected_wand_id)) {
            return MW_EPOCH_SELECT_CORRUPT_OR_CONFLICT;
        }
        ++present_count;
    }

    if (present_count == 0U) {
        if (provisioning_policy == MW_EPOCH_ALLOW_EXPLICIT_PROVISIONING) {
            return MW_EPOCH_SELECT_PROVISIONING_REQUIRED;
        }
        return MW_EPOCH_SELECT_NOT_FOUND;
    }
    if (present_count == 1U) {
        *selected = (slots[0].state == MW_EPOCH_SLOT_PRESENT)
            ? decoded[0]
            : decoded[1];
        return MW_EPOCH_SELECT_OK;
    }

    if (decoded[0].generation == decoded[1].generation) {
        return MW_EPOCH_SELECT_CORRUPT_OR_CONFLICT;
    }
    {
        const mw_epoch_record_t *newer = (decoded[0].generation > decoded[1].generation)
            ? &decoded[0]
            : &decoded[1];
        const mw_epoch_record_t *older = (newer == &decoded[0])
            ? &decoded[1]
            : &decoded[0];
        if ((older->generation >= (UINT32_MAX - 1U))
            || (newer->generation != (older->generation + 1U))
            || (newer->session_id <= older->session_id)) {
            return MW_EPOCH_SELECT_CORRUPT_OR_CONFLICT;
        }
        *selected = *newer;
    }
    return MW_EPOCH_SELECT_OK;
}
```

## src/mw_epoch_record.h
```c
#ifndef MW_EPOCH_RECORD_H
#define MW_EPOCH_RECORD_H

#include <stdbool.h>
#include <stddef.h>
#include <stdint.h>

#define MW_EPOCH_RECORD_ENCODED_SIZE 32U
#define MW_EPOCH_RECORD_SCHEMA_V1 1U
#define MW_EPOCH_LOGICAL_CHANNEL_COUNT 8U
#define MW_EPOCH_SLOT_COUNT 2U

typedef struct {
    uint8_t logical_channel;
    uint8_t copy_index;
    uint32_t generation;
    uint32_t receiver_id;
    uint32_t wand_id;
    uint32_t session_id;
    uint32_t sequence_ceiling;
} mw_epoch_record_t;

typedef enum {
    MW_EPOCH_SLOT_PRESENT = 0,
    MW_EPOCH_SLOT_ENOENT = 1,
    MW_EPOCH_SLOT_IO_ERROR = 2
} mw_epoch_slot_state_t;

typedef struct {
    mw_epoch_slot_state_t state;
    const uint8_t *data;
    size_t length;
} mw_epoch_slot_view_t;

typedef enum {
    MW_EPOCH_REQUIRE_EXISTING = 0,
    MW_EPOCH_ALLOW_EXPLICIT_PROVISIONING = 1
} mw_epoch_provisioning_policy_t;

typedef enum {
    MW_EPOCH_SELECT_OK = 0,
    MW_EPOCH_SELECT_PROVISIONING_REQUIRED,
    MW_EPOCH_SELECT_NOT_FOUND,
    MW_EPOCH_SELECT_IO_ERROR,
    MW_EPOCH_SELECT_CORRUPT_OR_CONFLICT,
    MW_EPOCH_SELECT_INVALID_ARGUMENT
} mw_epoch_select_result_t;

/*
 * Canonical 32-byte big-endian encoding:
 *   [0..3]   magic "MWEP"
 *   [4]      schema (1)
 *   [5]      logical channel (0..7)
 *   [6]      copy index (0=A, 1=B)
 *   [7]      reserved, canonical zero
 *   [8..11]  generation
 *   [12..15] receiver identity
 *   [16..19] wand identity
 *   [20..23] durable session epoch
 *   [24..27] sequence ceiling
 *   [28..31] CRC-32/ISO-HDLC over bytes [0..27]
 *
 * A persisted factory baseline is explicit and canonical:
 * generation=1, session_id=0, sequence_ceiling=0. Active records use
 * non-zero counters and reserve UINT32_MAX as the no-wrap sentinel.
 */
bool mw_epoch_record_encode(
    const mw_epoch_record_t *record,
    uint8_t encoded[MW_EPOCH_RECORD_ENCODED_SIZE]
);

bool mw_epoch_record_decode(
    const uint8_t *encoded,
    size_t encoded_length,
    mw_epoch_record_t *record
);

/* This constructor must only be called by an explicit provisioning flow. */
bool mw_epoch_record_make_factory_baseline(
    uint8_t logical_channel,
    uint8_t copy_index,
    uint32_t receiver_id,
    uint32_t wand_id,
    mw_epoch_record_t *record
);

/* Prepares the inactive A/B slot and rejects generation/session wrap. */
bool mw_epoch_record_prepare_next(
    const mw_epoch_record_t *current,
    uint32_t next_session_id,
    uint32_t sequence_ceiling,
    mw_epoch_record_t *next
);

/*
 * Selects only canonical records matching the expected channel and identities.
 * Equal generations, skipped generations, non-increasing sessions, malformed
 * present slots and any I/O error fail closed. The output is zero on failure.
 * Two ENOENT slots never manufacture state: explicit provisioning policy only
 * changes NOT_FOUND into PROVISIONING_REQUIRED.
 */
mw_epoch_select_result_t mw_epoch_record_select(
    const mw_epoch_slot_view_t slots[MW_EPOCH_SLOT_COUNT],
    uint8_t expected_logical_channel,
    uint32_t expected_receiver_id,
    uint32_t expected_wand_id,
    mw_epoch_provisioning_policy_t provisioning_policy,
    mw_epoch_record_t *selected
);

#endif
```

## src/mw_epoch_store.c
```c
#include "mw_epoch_store.h"

#include <string.h>

static void clear_channel(mw_epoch_store_channel_t *channel)
{
    const mw_epoch_store_channel_t zero = {0};
    *channel = zero;
}

static bool active_counter(uint32_t value)
{
    return (value != 0U) && (value != UINT32_MAX);
}

static bool identities_valid(uint32_t receiver_id, uint32_t wand_id)
{
    return (receiver_id != 0U)
        && (wand_id != 0U)
        && (receiver_id != wand_id);
}

static bool records_equal(
    const mw_epoch_record_t *left,
    const mw_epoch_record_t *right
)
{
    return (left->logical_channel == right->logical_channel)
        && (left->copy_index == right->copy_index)
        && (left->generation == right->generation)
        && (left->receiver_id == right->receiver_id)
        && (left->wand_id == right->wand_id)
        && (left->session_id == right->session_id)
        && (left->sequence_ceiling == right->sequence_ceiling);
}

static mw_epoch_store_result_t map_select_result(
    mw_epoch_select_result_t result
)
{
    switch (result) {
    case MW_EPOCH_SELECT_OK:
        return MW_EPOCH_STORE_OK;
    case MW_EPOCH_SELECT_PROVISIONING_REQUIRED:
        return MW_EPOCH_STORE_PROVISIONING_REQUIRED;
    case MW_EPOCH_SELECT_NOT_FOUND:
        return MW_EPOCH_STORE_NOT_FOUND;
    case MW_EPOCH_SELECT_IO_ERROR:
        return MW_EPOCH_STORE_IO_ERROR;
    case MW_EPOCH_SELECT_CORRUPT_OR_CONFLICT:
        return MW_EPOCH_STORE_CORRUPT_OR_CONFLICT;
    case MW_EPOCH_SELECT_INVALID_ARGUMENT:
    default:
        return MW_EPOCH_STORE_BACKEND_CONTRACT_ERROR;
    }
}

static mw_epoch_store_result_t read_views(
    mw_epoch_store_t *store,
    uint8_t logical_channel,
    uint8_t buffers[MW_EPOCH_SLOT_COUNT][MW_EPOCH_RECORD_ENCODED_SIZE],
    mw_epoch_slot_view_t views[MW_EPOCH_SLOT_COUNT]
)
{
    mw_epoch_slot_state_t states[MW_EPOCH_SLOT_COUNT];
    size_t lengths[MW_EPOCH_SLOT_COUNT] = {0U, 0U};
    unsigned int copy_index;

    for (copy_index = 0U; copy_index < MW_EPOCH_SLOT_COUNT; ++copy_index) {
        (void)memset(buffers[copy_index], 0, MW_EPOCH_RECORD_ENCODED_SIZE);
        states[copy_index] = store->backend.read_slot(
            store->backend.context,
            logical_channel,
            (uint8_t)copy_index,
            buffers[copy_index],
            &lengths[copy_index]);
    }

    /* A known backend I/O error has global precedence over format diagnosis. */
    for (copy_index = 0U; copy_index < MW_EPOCH_SLOT_COUNT; ++copy_index) {
        if (states[copy_index] == MW_EPOCH_SLOT_IO_ERROR) {
            return MW_EPOCH_STORE_IO_ERROR;
        }
    }

    for (copy_index = 0U; copy_index < MW_EPOCH_SLOT_COUNT; ++copy_index) {
        views[copy_index].state = states[copy_index];
        if (states[copy_index] == MW_EPOCH_SLOT_PRESENT) {
            views[copy_index].data = buffers[copy_index];
            views[copy_index].length = lengths[copy_index];
        } else if (states[copy_index] == MW_EPOCH_SLOT_ENOENT) {
            if (lengths[copy_index] != 0U) {
                return MW_EPOCH_STORE_BACKEND_CONTRACT_ERROR;
            }
            views[copy_index].data = NULL;
            views[copy_index].length = 0U;
        } else {
            return MW_EPOCH_STORE_BACKEND_CONTRACT_ERROR;
        }
    }
    return MW_EPOCH_STORE_OK;
}

static mw_epoch_store_result_t read_and_select(
    mw_epoch_store_t *store,
    uint8_t logical_channel,
    uint32_t receiver_id,
    uint32_t wand_id,
    mw_epoch_provisioning_policy_t provisioning_policy,
    uint8_t buffers[MW_EPOCH_SLOT_COUNT][MW_EPOCH_RECORD_ENCODED_SIZE],
    mw_epoch_slot_view_t views[MW_EPOCH_SLOT_COUNT],
    mw_epoch_record_t *selected
)
{
    mw_epoch_store_result_t read_result = read_views(
        store, logical_channel, buffers, views);
    if (read_result != MW_EPOCH_STORE_OK) {
        return read_result;
    }
    return map_select_result(mw_epoch_record_select(
        views,
        logical_channel,
        receiver_id,
        wand_id,
        provisioning_policy,
        selected));
}

static mw_epoch_store_result_t write_candidate(
    mw_epoch_store_t *store,
    mw_epoch_store_channel_t *channel,
    const mw_epoch_record_t *candidate
)
{
    uint8_t encoded[MW_EPOCH_RECORD_ENCODED_SIZE];
    uint8_t buffers[MW_EPOCH_SLOT_COUNT][MW_EPOCH_RECORD_ENCODED_SIZE];
    mw_epoch_slot_view_t views[MW_EPOCH_SLOT_COUNT];
    mw_epoch_record_t selected;
    mw_epoch_store_result_t result;
    int32_t write_result;
    size_t byte_index;

    if (!mw_epoch_record_encode(candidate, encoded)) {
        return MW_EPOCH_STORE_INVALID_ARGUMENT;
    }
    write_result = store->backend.write_slot(
        store->backend.context,
        candidate->logical_channel,
        candidate->copy_index,
        encoded,
        sizeof(encoded));
    if (write_result < 0) {
        return MW_EPOCH_STORE_IO_ERROR;
    }
    if ((write_result != 0)
        && (write_result != (int32_t)MW_EPOCH_RECORD_ENCODED_SIZE)) {
        return MW_EPOCH_STORE_BACKEND_CONTRACT_ERROR;
    }

    /* Both successful write forms (32 and unchanged=0) require full readback. */
    result = read_and_select(
        store,
        candidate->logical_channel,
        candidate->receiver_id,
        candidate->wand_id,
        MW_EPOCH_REQUIRE_EXISTING,
        buffers,
        views,
        &selected);
    if (result != MW_EPOCH_STORE_OK) {
        return result;
    }
    if ((views[candidate->copy_index].state != MW_EPOCH_SLOT_PRESENT)
        || (views[candidate->copy_index].length != sizeof(encoded))) {
        return MW_EPOCH_STORE_CORRUPT_OR_CONFLICT;
    }
    for (byte_index = 0U; byte_index < sizeof(encoded); ++byte_index) {
        if (views[candidate->copy_index].data[byte_index]
            != encoded[byte_index]) {
            return MW_EPOCH_STORE_CORRUPT_OR_CONFLICT;
        }
    }
    if (!records_equal(&selected, candidate)) {
        return MW_EPOCH_STORE_CORRUPT_OR_CONFLICT;
    }

    channel->current = selected;
    channel->ready = true;
    channel->provisioning_pending = false;
    return MW_EPOCH_STORE_OK;
}

bool mw_epoch_store_init(
    mw_epoch_store_t *store,
    const mw_epoch_store_backend_t *backend
)
{
    mw_epoch_store_backend_t configured;

    if (store == NULL) {
        return false;
    }
    if (backend == NULL) {
        (void)memset(store, 0, sizeof(*store));
        return false;
    }
    configured = *backend;
    (void)memset(store, 0, sizeof(*store));
    if ((configured.read_slot == NULL)
        || (configured.write_slot == NULL)) {
        return false;
    }
    store->backend = configured;
    store->initialized = true;
    return true;
}

mw_epoch_store_result_t mw_epoch_store_load_channel(
    mw_epoch_store_t *store,
    uint8_t logical_channel,
    uint32_t receiver_id,
    uint32_t wand_id,
    uint32_t configured_sequence_ceiling,
    mw_epoch_provisioning_policy_t provisioning_policy
)
{
    mw_epoch_store_channel_t configured = {0};
    uint8_t buffers[MW_EPOCH_SLOT_COUNT][MW_EPOCH_RECORD_ENCODED_SIZE];
    mw_epoch_slot_view_t views[MW_EPOCH_SLOT_COUNT];
    mw_epoch_record_t selected;
    mw_epoch_store_result_t result;

    if ((store != NULL)
        && store->initialized
        && (logical_channel < MW_EPOCH_LOGICAL_CHANNEL_COUNT)) {
        clear_channel(&store->channels[logical_channel]);
    }
    if ((store == NULL)
        || !store->initialized
        || (logical_channel >= MW_EPOCH_LOGICAL_CHANNEL_COUNT)
        || !identities_valid(receiver_id, wand_id)
        || !active_counter(configured_sequence_ceiling)
        || ((provisioning_policy != MW_EPOCH_REQUIRE_EXISTING)
            && (provisioning_policy != MW_EPOCH_ALLOW_EXPLICIT_PROVISIONING))) {
        return MW_EPOCH_STORE_INVALID_ARGUMENT;
    }

    configured.receiver_id = receiver_id;
    configured.wand_id = wand_id;
    configured.configured_sequence_ceiling = configured_sequence_ceiling;
    configured.identity_configured = true;
    result = read_and_select(
        store,
        logical_channel,
        receiver_id,
        wand_id,
        provisioning_policy,
        buffers,
        views,
        &selected);
    if (result == MW_EPOCH_STORE_OK) {
        configured.current = selected;
        configured.ready = true;
        store->channels[logical_channel] = configured;
    } else if (result == MW_EPOCH_STORE_PROVISIONING_REQUIRED) {
        configured.provisioning_pending = true;
        store->channels[logical_channel] = configured;
    } else {
        /* Channel was already cleared before any backend read. */
    }
    return result;
}

mw_epoch_store_result_t mw_epoch_store_provision_channel(
    mw_epoch_store_t *store,
    uint8_t logical_channel
)
{
    mw_epoch_store_channel_t *channel;
    mw_epoch_record_t baseline;
    mw_epoch_store_result_t result;

    if ((store == NULL)
        || !store->initialized
        || (logical_channel >= MW_EPOCH_LOGICAL_CHANNEL_COUNT)) {
        return MW_EPOCH_STORE_INVALID_ARGUMENT;
    }
    channel = &store->channels[logical_channel];
    if (!channel->identity_configured
        || !channel->provisioning_pending
        || channel->ready) {
        return MW_EPOCH_STORE_NOT_READY;
    }
    if (!mw_epoch_record_make_factory_baseline(
            logical_channel,
            0U,
            channel->receiver_id,
            channel->wand_id,
            &baseline)) {
        clear_channel(channel);
        return MW_EPOCH_STORE_INVALID_ARGUMENT;
    }

    result = write_candidate(store, channel, &baseline);
    if (result != MW_EPOCH_STORE_OK) {
        clear_channel(channel);
    }
    return result;
}

mw_epoch_store_result_t mw_epoch_store_commit_session(
    mw_epoch_store_t *store,
    uint8_t logical_channel,
    uint32_t next_session_id
)
{
    mw_epoch_store_channel_t *channel;
    mw_epoch_record_t candidate;
    mw_epoch_store_result_t result;

    if ((store == NULL)
        || !store->initialized
        || (logical_channel >= MW_EPOCH_LOGICAL_CHANNEL_COUNT)) {
        return MW_EPOCH_STORE_INVALID_ARGUMENT;
    }
    channel = &store->channels[logical_channel];
    if (!channel->ready || !channel->identity_configured) {
        return MW_EPOCH_STORE_NOT_READY;
    }
    if (!mw_epoch_record_prepare_next(
            &channel->current,
            next_session_id,
            channel->configured_sequence_ceiling,
            &candidate)) {
        return MW_EPOCH_STORE_INVALID_ARGUMENT;
    }

    result = write_candidate(store, channel, &candidate);
    if (result != MW_EPOCH_STORE_OK) {
        clear_channel(channel);
    }
    return result;
}

bool mw_epoch_store_snapshot(
    const mw_epoch_store_t *store,
    uint8_t logical_channel,
    mw_epoch_record_t *record_out
)
{
    if (record_out != NULL) {
        const mw_epoch_record_t zero = {0};
        *record_out = zero;
    }
    if ((store == NULL)
        || !store->initialized
        || (record_out == NULL)
        || (logical_channel >= MW_EPOCH_LOGICAL_CHANNEL_COUNT)
        || !store->channels[logical_channel].ready) {
        return false;
    }
    *record_out = store->channels[logical_channel].current;
    return true;
}

bool mw_epoch_store_channel_ready(
    const mw_epoch_store_t *store,
    uint8_t logical_channel
)
{
    return (store != NULL)
        && store->initialized
        && (logical_channel < MW_EPOCH_LOGICAL_CHANNEL_COUNT)
        && store->channels[logical_channel].ready;
}

void mw_epoch_store_invalidate_channel(
    mw_epoch_store_t *store,
    uint8_t logical_channel
)
{
    if ((store != NULL)
        && store->initialized
        && (logical_channel < MW_EPOCH_LOGICAL_CHANNEL_COUNT)) {
        clear_channel(&store->channels[logical_channel]);
    }
}

bool mw_epoch_store_channel_context_init(
    mw_epoch_store_channel_context_t *context,
    mw_epoch_store_t *store,
    uint8_t logical_channel
)
{
    if (context != NULL) {
        context->store = NULL;
        context->logical_channel = 0U;
    }
    if ((context == NULL)
        || (store == NULL)
        || !store->initialized
        || (logical_channel >= MW_EPOCH_LOGICAL_CHANNEL_COUNT)) {
        return false;
    }
    context->store = store;
    context->logical_channel = logical_channel;
    return true;
}

bool mw_epoch_store_commit_session_epoch(
    void *context,
    uint32_t next_session_id
)
{
    mw_epoch_store_channel_context_t *channel_context =
        (mw_epoch_store_channel_context_t *)context;
    if (channel_context == NULL) {
        return false;
    }
    return mw_epoch_store_commit_session(
        channel_context->store,
        channel_context->logical_channel,
        next_session_id) == MW_EPOCH_STORE_OK;
}
```

## src/mw_epoch_store.h
```c
#ifndef MW_EPOCH_STORE_H
#define MW_EPOCH_STORE_H

#include "mw_epoch_record.h"

#include <stdbool.h>
#include <stddef.h>
#include <stdint.h>

typedef mw_epoch_slot_state_t (*mw_epoch_backend_read_slot_fn)(
    void *context,
    uint8_t logical_channel,
    uint8_t copy_index,
    uint8_t data_out[MW_EPOCH_RECORD_ENCODED_SIZE],
    size_t *stored_length_out
);

/*
 * Mirrors nvs_write semantics without depending on ssize_t or Zephyr:
 * encoded length means written, zero means identical data already existed,
 * a negative value means I/O failure, and any other positive value is a
 * forbidden short write.
 */
typedef int32_t (*mw_epoch_backend_write_slot_fn)(
    void *context,
    uint8_t logical_channel,
    uint8_t copy_index,
    const uint8_t *data,
    size_t data_length
);

typedef struct {
    mw_epoch_backend_read_slot_fn read_slot;
    mw_epoch_backend_write_slot_fn write_slot;
    void *context;
} mw_epoch_store_backend_t;

typedef enum {
    MW_EPOCH_STORE_OK = 0,
    MW_EPOCH_STORE_PROVISIONING_REQUIRED,
    MW_EPOCH_STORE_NOT_FOUND,
    MW_EPOCH_STORE_CORRUPT_OR_CONFLICT,
    MW_EPOCH_STORE_IO_ERROR,
    MW_EPOCH_STORE_BACKEND_CONTRACT_ERROR,
    MW_EPOCH_STORE_INVALID_ARGUMENT,
    MW_EPOCH_STORE_NOT_READY
} mw_epoch_store_result_t;

typedef struct {
    mw_epoch_record_t current;
    uint32_t receiver_id;
    uint32_t wand_id;
    uint32_t configured_sequence_ceiling;
    bool identity_configured;
    bool ready;
    bool provisioning_pending;
} mw_epoch_store_channel_t;

typedef struct {
    mw_epoch_store_backend_t backend;
    mw_epoch_store_channel_t channels[MW_EPOCH_LOGICAL_CHANNEL_COUNT];
    bool initialized;
} mw_epoch_store_t;

typedef struct {
    mw_epoch_store_t *store;
    uint8_t logical_channel;
} mw_epoch_store_channel_context_t;

bool mw_epoch_store_init(
    mw_epoch_store_t *store,
    const mw_epoch_store_backend_t *backend
);

/*
 * Loads and selects A/B state. Double ENOENT returns NOT_FOUND unless the
 * caller explicitly supplies ALLOW_EXPLICIT_PROVISIONING, in which case it
 * returns PROVISIONING_REQUIRED without writing anything.
 */
mw_epoch_store_result_t mw_epoch_store_load_channel(
    mw_epoch_store_t *store,
    uint8_t logical_channel,
    uint32_t receiver_id,
    uint32_t wand_id,
    uint32_t configured_sequence_ceiling,
    mw_epoch_provisioning_policy_t provisioning_policy
);

/* Writes the canonical factory baseline only after the explicit load result. */
mw_epoch_store_result_t mw_epoch_store_provision_channel(
    mw_epoch_store_t *store,
    uint8_t logical_channel
);

/*
 * Transaction: prepare inactive slot -> encode -> write -> full read of both
 * slots -> exact candidate readback -> canonical reselect -> current update.
 * Current is never updated before every step succeeds. Any ambiguous storage
 * failure invalidates only this logical channel and requires a fresh load.
 */
mw_epoch_store_result_t mw_epoch_store_commit_session(
    mw_epoch_store_t *store,
    uint8_t logical_channel,
    uint32_t next_session_id
);

bool mw_epoch_store_snapshot(
    const mw_epoch_store_t *store,
    uint8_t logical_channel,
    mw_epoch_record_t *record_out
);

bool mw_epoch_store_channel_ready(
    const mw_epoch_store_t *store,
    uint8_t logical_channel
);

void mw_epoch_store_invalidate_channel(
    mw_epoch_store_t *store,
    uint8_t logical_channel
);

bool mw_epoch_store_channel_context_init(
    mw_epoch_store_channel_context_t *context,
    mw_epoch_store_t *store,
    uint8_t logical_channel
);

/* Portable runtime callback: ACK is forbidden unless this returns true. */
bool mw_epoch_store_commit_session_epoch(
    void *context,
    uint32_t next_session_id
);

#endif
```
